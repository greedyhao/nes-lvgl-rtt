## bsp/qemu-vexpress-a9/drivers/Kconfig
```kconfig
config RT_USING_UART0
    bool "Enable UART0"
    default n

config RT_USING_UART1
    bool "Enable UART1"
    default y

config BSP_DRV_CLCD
    bool "CLCD driver"
    # depends on PKG_USING_GUIENGINE
    default y

if BSP_DRV_CLCD
    config BSP_LCD_WIDTH
    int "Width of LCD panel"
    default 640

    config BSP_LCD_HEIGHT
    int "Height of LCD panel"
    default 480
endif

config BSP_DRV_EMAC
    bool "EMAC driver"
    depends on RT_USING_LWIP
    default y

config BSP_DRV_AUDIO
    bool "Audio driver"
    select RT_USING_AUDIO
    default n

# this config should not be here
config PKG_USING_NES2RTT_O
    bool "Enable nes emulator"
    default y

config PKG_USING_InfoNES2RTT
    bool "Enable infones emulator"
    default y
```
